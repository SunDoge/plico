## apps/lvgl-esp32p4/idf/sdkconfig.defaults
```kconfig
CONFIG_IDF_TARGET="esp32p4"
CONFIG_ESP32P4_REV_MIN_300=y
CONFIG_ESP32P4_SELECTS_REV_LESS_V3=n
CONFIG_ESP_DEFAULT_CPU_FREQ_MHZ_400=y
CONFIG_ESPTOOLPY_FLASHSIZE_32MB=y
CONFIG_ESPTOOLPY_FLASHMODE_DIO=y
CONFIG_PARTITION_TABLE_CUSTOM=y
CONFIG_PARTITION_TABLE_CUSTOM_FILENAME="partitions.csv"
CONFIG_PARTITION_TABLE_OFFSET=0x8000
CONFIG_SPIRAM=y
CONFIG_SPIRAM_MODE_HEX=y
CONFIG_SPIRAM_SPEED_250M=y
CONFIG_SPIRAM_FETCH_INSTRUCTIONS=y
CONFIG_SPIRAM_RODATA=y
CONFIG_SPIRAM_XIP_FROM_PSRAM=y
CONFIG_SPIRAM_MALLOC_ALWAYSINTERNAL=0
CONFIG_SPIRAM_MALLOC_RESERVE_INTERNAL=16384
CONFIG_CACHE_L2_CACHE_256KB=y
CONFIG_CACHE_L2_CACHE_LINE_128B=y
CONFIG_ESP_CONSOLE_UART_DEFAULT=n
CONFIG_ESP_CONSOLE_UART_CUSTOM=y
CONFIG_ESP_CONSOLE_UART_CUSTOM_NUM_0=y
CONFIG_ESP_CONSOLE_UART_TX_GPIO=37
CONFIG_ESP_CONSOLE_UART_RX_GPIO=38
CONFIG_ESP_CONSOLE_UART_BAUDRATE=2000000
CONFIG_FREERTOS_HZ=1000
CONFIG_FREERTOS_GENERATE_RUN_TIME_STATS=y
CONFIG_FREERTOS_RUN_TIME_STATS_USING_ESP_TIMER=y
CONFIG_ESP_MAIN_TASK_STACK_SIZE=8192
CONFIG_COMPILER_OPTIMIZATION_SIZE=y
CONFIG_BSP_I2C_CLK_SPEED_HZ=400000
CONFIG_BSP_LCD_DPI_BUFFER_NUMS=3
CONFIG_BSP_LCD_COLOR_FORMAT_RGB565=y
CONFIG_LV_OS_FREERTOS=y
CONFIG_LV_BUILD_EXAMPLES=n
CONFIG_LV_BUILD_DEMOS=n
CONFIG_LV_USE_CLIB_MALLOC=y
CONFIG_LV_USE_CLIB_STRING=y
CONFIG_LV_USE_CLIB_SPRINTF=y
CONFIG_LV_DEF_REFR_PERIOD=20
CONFIG_LV_USE_FLOAT=y
CONFIG_LV_USE_LOG=y
CONFIG_LV_USE_SNAPSHOT=y
CONFIG_LV_USE_MATRIX=y
CONFIG_LV_USE_PRIVATE_API=y
CONFIG_LV_USE_BIDI=y
CONFIG_LV_USE_CALENDAR_CHINESE=y
CONFIG_LV_USE_GRIDNAV=y
CONFIG_LV_USE_TRANSLATION=y
CONFIG_LV_USE_THEME_MONO=y
CONFIG_LV_FONT_MONTSERRAT_16=y
CONFIG_LV_FONT_MONTSERRAT_24=y
```
